## firmware/main/Kconfig.projbuild
```kconfig
menu "Digi-Dash Configuration"

    choice DIGI_DASH_TARGET
        prompt "Target Hardware"
        default DIGI_DASH_TARGET_QEMU
        help
            Select the target hardware for the build.

        config DIGI_DASH_TARGET_QEMU
            bool "QEMU Simulator"
            help
                Build for QEMU ESP32-S3 simulator with virtual RGB display.

        config DIGI_DASH_TARGET_HARDWARE
            bool "Hardware (NV3052C)"
            help
                Build for real hardware with NV3052C RGB display panel.
    endchoice

endmenu
```

## firmware/sdkconfig.defaults
```kconfig
# Target ESP32-S3
CONFIG_IDF_TARGET="esp32s3"

# Enable PSRAM for frame buffer
CONFIG_SPIRAM=y
CONFIG_SPIRAM_MODE_OCT=y
CONFIG_SPIRAM_SPEED_80M=y
CONFIG_SPIRAM_USE_MALLOC=y
CONFIG_SPIRAM_MALLOC_ALWAYSINTERNAL=16384
```

## sdkconfig.defaults
```kconfig
# ESP32-S3 Target
CONFIG_IDF_TARGET="esp32s3"

# Enable ThorVG for SVG support in LVGL
CONFIG_LV_USE_THORVG=y
CONFIG_LV_USE_SVG=y
CONFIG_LV_USE_VECTOR_GRAPHIC=y
CONFIG_LV_USE_DRAW_SW=y
CONFIG_LV_USE_PNG=y
CONFIG_LV_USE_BMP=y
# Partition table
CONFIG_PARTITION_TABLE_CUSTOM=y
CONFIG_PARTITION_TABLE_CUSTOM_FILENAME="partitions.csv"
CONFIG_PARTITION_TABLE_FILENAME="partitions.csv"
```

## test_app/sdkconfig.defaults
```kconfig
# Test app configuration
CONFIG_UNITY_ENABLE_DOUBLE=y
CONFIG_UNITY_ENABLE_FLOAT=y
CONFIG_UNITY_ENABLE_64BIT=y
CONFIG_UNITY_ENABLE_COLOR=y
```
